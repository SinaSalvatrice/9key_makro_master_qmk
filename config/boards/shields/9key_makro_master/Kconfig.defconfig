## config/boards/shields/9key_makro_master/Kconfig.defconfig
```kconfig
if SHIELD_9KEY_MAKRO_MASTER

config ZMK_KEYBOARD_NAME
    default "9key Makro Master"

endif
```

## config/boards/shields/9key_makro_master/Kconfig.shield
```kconfig
config SHIELD_9KEY_MAKRO_MASTER
    def_bool $(shields_list_contains,9key_makro_master)
```

## zmk-config/config/shields/nicenano_3x3/Kconfig.shield
```kconfig
# SPDX-License-Identifier: MIT

config SHIELD_NICENANO_3X3
    def_bool $(shields_list_contains,nicenano_3x3)
```
